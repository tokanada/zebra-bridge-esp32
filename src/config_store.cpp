#include "config_store.h"

#include <Arduino.h>

#include "board_config.h"

// Generated by scripts/bridge_config.py for the ESP32 environments. The
// native test build does not run that script, so a missing header means "no
// overrides" and the code below falls back to board_config.h.
#if defined(__has_include)
#if __has_include("bridge_config_gen.h")
#include "bridge_config_gen.h"
#endif
#endif

#ifndef ZB_CFG_HASH
#define ZB_CFG_HASH 0x811c9dc5u
#endif
#ifndef ZB_CFG_SOURCE
#define ZB_CFG_SOURCE "none"
#endif

namespace {

constexpr const char* kNamespace = "zbridge";
constexpr const char* kConfigHashKey = "cfghash";

}  // namespace

std::uint32_t buildConfigHash() { return ZB_CFG_HASH; }

const char* buildConfigSource() { return ZB_CFG_SOURCE; }

Config defaultConfig() {
  Config config;
  config.name = ZB_DEFAULT_NAME;
  config.serial = ZB_DEFAULT_SERIAL;
  config.baud = ZB_DEFAULT_BAUD;
  config.flow = console::FlowMode::XonXoff;
  config.txPin = ZB_PIN_TX;
  config.rxPin = ZB_PIN_RX;
  config.ctsPin = ZB_PIN_CTS;
  config.ledPin = ZB_PIN_LED;
  config.ledActiveLow = ZB_LED_ACTIVE_LOW != 0;
  config.log = console::LogLevel::Info;

  // Build-time overrides from bridge.ini sit on top of the board defaults.
#ifdef ZB_CFG_HAS_NAME
  config.name = ZB_CFG_NAME;
#endif
#ifdef ZB_CFG_HAS_SERIAL
  config.serial = ZB_CFG_SERIAL;
#endif
#ifdef ZB_CFG_HAS_BAUD
  config.baud = static_cast<std::uint32_t>(ZB_CFG_BAUD);
#endif
#ifdef ZB_CFG_HAS_FLOW
  config.flow = static_cast<console::FlowMode>(ZB_CFG_FLOW);
#endif
#ifdef ZB_CFG_HAS_TX
  config.txPin = ZB_CFG_TX;
#endif
#ifdef ZB_CFG_HAS_RX
  config.rxPin = ZB_CFG_RX;
#endif
#ifdef ZB_CFG_HAS_CTS
  config.ctsPin = ZB_CFG_CTS;
#endif
#ifdef ZB_CFG_HAS_LED
  config.ledPin = ZB_CFG_LED;
#endif
#ifdef ZB_CFG_HAS_LEDLOW
  config.ledActiveLow = ZB_CFG_LEDLOW != 0;
#endif
#ifdef ZB_CFG_HAS_LOG
  config.log = static_cast<console::LogLevel>(ZB_CFG_LOG);
#endif

  return config;
}

void ConfigStore::begin() {
  prefs_.begin(kNamespace, false);

  const std::uint32_t expected = buildConfigHash();
  const bool hasHash = prefs_.isKey(kConfigHashKey);
  const std::uint32_t stored =
      hasHash ? prefs_.getUInt(kConfigHashKey, 0) : 0;

  if (!hasHash || stored != expected) {
    prefs_.clear();
    prefs_.putUInt(kConfigHashKey, expected);
    Serial.printf(
        "config: applied %s (hash 0x%08x), cleared saved console settings\n",
        buildConfigSource(), static_cast<unsigned>(expected));
  }
}

Config ConfigStore::load() const {
  Config config = defaultConfig();

  if (prefs_.isKey("name")) {
    const String value = prefs_.getString("name", config.name.c_str());
    config.name = value.c_str();
  }
  if (prefs_.isKey("serial")) {
    const String value = prefs_.getString("serial", config.serial.c_str());
    config.serial = value.c_str();
  }
  if (prefs_.isKey("baud")) {
    config.baud = prefs_.getUInt("baud", config.baud);
  }
  if (prefs_.isKey("flow")) {
    config.flow = static_cast<console::FlowMode>(
        prefs_.getUChar("flow", static_cast<std::uint8_t>(config.flow)));
  }
  if (prefs_.isKey("tx")) {
    config.txPin = prefs_.getInt("tx", config.txPin);
  }
  if (prefs_.isKey("rx")) {
    config.rxPin = prefs_.getInt("rx", config.rxPin);
  }
  if (prefs_.isKey("cts")) {
    config.ctsPin = prefs_.getInt("cts", config.ctsPin);
  }
  if (prefs_.isKey("led")) {
    config.ledPin = prefs_.getInt("led", config.ledPin);
  }
  if (prefs_.isKey("ledlow")) {
    config.ledActiveLow = prefs_.getBool("ledlow", config.ledActiveLow);
  }
  if (prefs_.isKey("log")) {
    config.log = static_cast<console::LogLevel>(
        prefs_.getUChar("log", static_cast<std::uint8_t>(config.log)));
  }

  return config;
}

void ConfigStore::save(const Config& config) {
  prefs_.putString("name", config.name.c_str());
  prefs_.putString("serial", config.serial.c_str());
  prefs_.putUInt("baud", config.baud);
  prefs_.putUChar("flow", static_cast<std::uint8_t>(config.flow));
  prefs_.putInt("tx", config.txPin);
  prefs_.putInt("rx", config.rxPin);
  prefs_.putInt("cts", config.ctsPin);
  prefs_.putInt("led", config.ledPin);
  prefs_.putBool("ledlow", config.ledActiveLow);
  prefs_.putUChar("log", static_cast<std::uint8_t>(config.log));
}

void ConfigStore::clear() {
  prefs_.clear();
  // Keep the build hash so the next boot does not treat this as a new config
  // and log a spurious "cleared saved console settings".
  prefs_.putUInt(kConfigHashKey, buildConfigHash());
}
